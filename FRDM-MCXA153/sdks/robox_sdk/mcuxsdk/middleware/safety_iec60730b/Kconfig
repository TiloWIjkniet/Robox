## FRDM_MCXA153_V2/Robox_V2/__repo__/mcuxsdk/components/crypto_benchmark/Kconfig
```kconfig
# Copyright 2025 NXP
# SPDX-License-Identifier: BSD-3-Clause

menu "Crypto Benchmark"
    config MCUX_COMPONENT_component.crypto_benchmark
        bool "Crypto Benchmark Core"

    config MCUX_COMPONENT_component.crypto_benchmark.port.ele_s400
        bool "ELE S400 Port"
        select MCUX_COMPONENT_component.crypto_benchmark
        select MCUX_COMPONENT_driver.s3mu
        select MCUX_COMPONENT_component.ele_crypto

    config MCUX_COMPONENT_component.crypto_benchmark.port.ele_s200
        bool "ELE S200 Port"
        select MCUX_COMPONENT_component.crypto_benchmark
        select MCUX_COMPONENT_middleware.secure-subsystem
        select MCUX_COMPONENT_middleware.secure-subsystem.elemu
        select MCUX_COMPONENT_driver.elemu

    config MCUX_COMPONENT_component.crypto_benchmark.port.custom
        bool "Custom Port"
        select MCUX_COMPONENT_component.crypto_benchmark

######################### PSA #########################

    # This one is common for all PSA layers
    config MCUX_COMPONENT_component.crypto_benchmark.port.psa
        bool
        default n
        select MCUX_COMPONENT_component.crypto_benchmark

    config MCUX_COMPONENT_component.crypto_benchmark.port.psa.ele_s200
        bool "PSA ELE S200 Port"
        select MCUX_COMPONENT_component.crypto_benchmark.port.psa
        select MCUX_COMPONENT_component.psa_crypto_driver.ele_s200
        depends on MCUX_HW_DEVICE_KW47B42Z83 || MCUX_HW_DEVICE_KW47B42Z96 || MCUX_HW_DEVICE_KW47B42Z97 || MCUX_HW_DEVICE_KW47B42ZB2 || MCUX_HW_DEVICE_KW47B42ZB3 || MCUX_HW_DEVICE_KW47B42ZB6 || MCUX_HW_DEVICE_KW47B42ZB7 || MCUX_HW_DEVICE_KW47Z42082 || MCUX_HW_DEVICE_KW47Z42092 || MCUX_HW_DEVICE_KW47Z420B2 || MCUX_HW_DEVICE_KW47Z420B3 || \
                   MCUX_HW_DEVICE_KW45B41Z52 || MCUX_HW_DEVICE_KW45B41Z53 || MCUX_HW_DEVICE_KW45B41Z82 || MCUX_HW_DEVICE_KW45B41Z83 || MCUX_HW_DEVICE_KW45Z41052 || MCUX_HW_DEVICE_KW45Z41053 || MCUX_HW_DEVICE_KW45Z41082 || MCUX_HW_DEVICE_KW45Z41083

    config MCUX_COMPONENT_component.crypto_benchmark.port.psa.ele_s4xx_psa
        bool "PSA ELE S4xx Port"
        select MCUX_COMPONENT_component.crypto_benchmark.port.psa
        select MCUX_COMPONENT_component.psa_crypto_driver.ele_s4xx_psa
        depends on MCUX_HW_DEVICE_MIMXRT1181 || MCUX_HW_DEVICE_MIMXRT1182 || MCUX_HW_DEVICE_MIMXRT1187 || MCUX_HW_DEVICE_MIMXRT1189

    config MCUX_COMPONENT_component.crypto_benchmark.port.psa.els_pkc
        bool "PSA ELS PKC Port"
        select MCUX_COMPONENT_component.crypto_benchmark.port.psa
        select MCUX_COMPONENT_component.psa_crypto_driver.els_pkc
        depends on MCUX_HW_DEVICE_MIMXRT735S || MCUX_HW_DEVICE_MIMXRT758S || MCUX_HW_DEVICE_MIMXRT798S || \
                   MCUX_HW_DEVICE_MCXN546 ||  MCUX_HW_DEVICE_MCXN547 || MCUX_HW_DEVICE_MCXN946 || MCUX_HW_DEVICE_MCXN947

    config MCUX_COMPONENT_component.crypto_benchmark.port.psa.sgi
        bool "PSA SGI Port"
        select MCUX_COMPONENT_component.crypto_benchmark.port.psa
        select MCUX_COMPONENT_component.psa_crypto_driver.sgi
        depends on MCUX_HW_DEVICE_MCXA175 || MCUX_HW_DEVICE_MCXA176 || MCUX_HW_DEVICE_MCXA185 || MCUX_HW_DEVICE_MCXA186 || \
                   MCUX_HW_DEVICE_MCXA255 || MCUX_HW_DEVICE_MCXA256 || MCUX_HW_DEVICE_MCXA265 || MCUX_HW_DEVICE_MCXA266 || \
                   MCUX_HW_DEVICE_MCXA345 || MCUX_HW_DEVICE_MCXA346 || MCUX_HW_DEVICE_MCXA355 || MCUX_HW_DEVICE_MCXA356 || \
                   MCUX_HW_DEVICE_MCXA365 || MCUX_HW_DEVICE_MCXA366 || MCUX_HW_DEVICE_MCXL253 || MCUX_HW_DEVICE_MCXL254 || \
                   MCUX_HW_DEVICE_MCXL255

    config MBEDTLS_PSA_ASSUME_EXCLUSIVE_BUFFERS
        default 0x1
        hex "PSA should assume exclusive buffers"
        depends on MCUX_COMPONENT_component.crypto_benchmark.port.psa
        help
            No prefix in generated macro
            This is defined to prevent PSA from copying the input and output buffers.
            For more detail see `<sdk_root>/middleware/mbedtls3x/docs/architecture/psa-shared-memory.md`.
endmenu
```

## FRDM_MCXA153_V2/Robox_V2/__repo__/mcuxsdk/middleware/safety_iec60730b/west.yml
```yaml
# Copyright 2025 NXP
#
# SPDX-License-Identifier: Apache-2.0
#
# Safety_iec60730b Zephyr west manifest
#
# Description:
#   Used for setting up freestanding safety_iec60730b module and only necessary Zephyr components.
#
# How to set up:
#   safety_iec60730b module initialization
#     1. west init -m <iec60730b_repository_URL> [--mr <iec60730b_revision_or_branch>] <folder_name>
#     2. cd <folder_name>
#     3. west update
#
# For more information, see zephyr/README.rst
#

manifest:
  self:
    path: modules/safety/iec60730b

  remotes:
    - name: zephyrproject-rtos
      url-base: https://github.com/zephyrproject-rtos

  projects:
    - name: zephyr
      remote: zephyrproject-rtos
      revision: v4.3.0-rc1
      import:
        name-allowlist:
          - cmsis_6    # required by the ARM port for Cortex-M
          - hal_nxp    # required by NXP boards
```

## FRDM_MCXA153_V2/Robox_V2/__repo__/mcuxsdk/middleware/se_hostlib/Kconfig
```kconfig
#
# Copyright 2024,2025 NXP
#
# SPDX-License-Identifier: BSD-3-Clause
#


menu "SE Hostlib"

    menu "SE05X Libraries"

    config MCUX_COMPONENT_middleware.se_hostlib.commonSe050
        bool "SE050 Library"
        default n
        help
            Common SE050 hostlib and sss library files
        select MCUX_COMPONENT_middleware.se_hostlib.commonSe050_ksdk
        select MCUX_COMPONENT_middleware.se_hostlib.commonSe050smCom
        select MCUX_COMPONENT_middleware.se_hostlib.commonSe050infra
        select MCUX_COMPONENT_middleware.se_hostlib.commonSe050_sss_ex
        select MCUX_COMPONENT_middleware.se_hostlib.commonSe050_CurrentApplet
        select MCUX_COMPONENT_middleware.se_hostlib.commonSe050_Scp03
        select MCUX_COMPONENT_middleware.se_hostlib.mwlog

    config MCUX_COMPONENT_middleware.se_hostlib.commonSe050_mcxa
        bool "SE05X Library for Low Power MCUs (MCXA153)"
        default n
        help
            Common SE050 hostlib and sss library files for Low Power MCUs (MCXA153 - SCP Excluded)
        select MCUX_COMPONENT_middleware.se_hostlib.commonSe050_ksdk
        select MCUX_COMPONENT_middleware.se_hostlib.commonSe050smCom
        select MCUX_COMPONENT_middleware.se_hostlib.commonSe050infra
        select MCUX_COMPONENT_middleware.se_hostlib.commonSe050_sss_ex
        select MCUX_COMPONENT_middleware.se_hostlib.commonSe050_CurrentApplet
        select MCUX_COMPONENT_middleware.se_hostlib.mwlog

    endmenu

    menu "SE05X Components"

    config MCUX_COMPONENT_middleware.se_hostlib.commonSe050_ksdk
        bool "Host MCU Drivers"
        default n
        help
            Host MCU driver files

    config MCUX_COMPONENT_middleware.se_hostlib.commonSe050smCom
        bool "Secure MW Communication"
        default n
        help
            Secure Middleware Communication Files

    config MCUX_COMPONENT_middleware.se_hostlib.commonSe050infra
        bool "Utilities"
        default n
        help
            Common Utilities

    config MCUX_COMPONENT_middleware.se_hostlib.commonSe050_sss_ex
        bool "Bootup"
        default n
        help
            Host Bootup files

    config MCUX_COMPONENT_middleware.se_hostlib.commonSe050_CurrentApplet
        bool "Current Applet Support"
        default n
        help
            Current Applet Support

    config MCUX_COMPONENT_middleware.se_hostlib.commonSe050_Scp03
        bool "Secure Channel Protocol (SCP-03)"
        default n
        help
            Add Platfrom SCP-03 support

    config MCUX_COMPONENT_middleware.se_hostlib.serial_manager_usb_cdc
        bool "Serial Manager USB_CDC"
        default n
        help
            Serial Manager USB_CDC
        select MCUX_COMPONENT_middleware.usb.device.cdc.external

    config MCUX_COMPONENT_middleware.se_hostlib.mwlog
        bool "MW Log"
        default n
        help
            Middleware logs

    config MCUX_COMPONENT_middleware.se_hostlib.mbedtls_alt_demo_common
        bool "mbedtls Alt"
        default n
        help
            Mbedtls Alt

    config MCUX_COMPONENT_middleware.se_hostlib.tstutils
        bool "Hostlib Utilities"
        default n
        help
            Hostlib Time Utilities
        select MCUX_COMPONENT_middleware.se_hostlib.tstutils.time

    config MCUX_COMPONENT_middleware.se_hostlib.tstutils.time
        bool "Hostlib Time Utilities"
        default n
        help
            Hostlib Time Utilities

    endmenu

    menu "SE05X Secure Subsystem"

    config MCUX_COMPONENT_middleware.se_hostlib.mbedtls_sss
        bool "mbedtls SSS ALT"
        default n
        help
            Include Mbedtls SSS ALT
        select MCUX_COMPONENT_middleware.se_hostlib.commonSe050
        select MCUX_COMPONENT_middleware.se_hostlib.mbedtls_alt_demo_common

    config MCUX_COMPONENT_middleware.se_hostlib.mbedtls_sss_mcx
        bool "mbedtls SSS ALT for MCXN MCUs"
        default n
        help
            Include Mbedtls ALT for MCXN MCUs
        select MCUX_COMPONENT_middleware.se_hostlib.commonSe050
        select MCUX_COMPONENT_middleware.se_hostlib.commonSe050_sss_ex

    config MCUX_COMPONENT_middleware.se_hostlib.sss_lp
        bool "SSS for Low Power MCUs (MCXA)"
        default n
        help
            Include Secure Subsystem files for Low Power MCUs (MCXA153)
        select MCUX_COMPONENT_middleware.se_hostlib.commonSe050_mcxa
        select MCUX_COMPONENT_middleware.se_hostlib.commonSe050_sss_ex

    endmenu

    menu "SE05X Cloud Demos"

    config MCUX_COMPONENT_middleware.se_hostlib.commonSe050CloudDemos
        bool "Cloud Library"
        default n
        help
            Common files for cloud demos
        select MCUX_COMPONENT_middleware.se_hostlib.commonSe050
        select MCUX_COMPONENT_middleware.se_hostlib.commonCloudDemos
        select MCUX_COMPONENT_middleware.se_hostlib.mbedtls_sss

    config MCUX_COMPONENT_middleware.se_hostlib.commonCloudDemos
        bool "Freertos"
        default n
        help
            Include  Freertos and PKCS for cloud demos
        select MCUX_COMPONENT_middleware.freertos.coremqtt
        select MCUX_COMPONENT_middleware.pkcs11
        select MCUX_COMPONENT_middleware.freertos.backoffalgorithm

    config MCUX_COMPONENT_middleware.se_hostlib.cloud_Wifi
        bool "Wifi"
        default n
        help
            Include Wifi for cloud demo
        select MCUX_COMPONENT_driver.flexcomm_i2c_freertos
        select MCUX_COMPONENT_middleware.freertos-kernel.cm33_non_trustzone

    endmenu

endmenu

if MCUX_COMPONENT_middleware.se_hostlib.commonCloudDemos
    choice MCUX_MISC_middleware.freertos-kernel.dynamic_allocator.selection
        default MCUX_COMPONENT_middleware.freertos-kernel.heap_4
    endchoice
endif
```
