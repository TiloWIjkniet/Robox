## FRDM-MCXA153/sdks/robox_sdk/mcuxsdk/middleware/safety_iec60730b/Kconfig
```kconfig
### Safety IEC60730 class B library

menuconfig MCUX_COMPONENT_middleware.safety
    bool "Safety IEC60730b"
    help
        Safety IEC60730 class B library.

    if MCUX_COMPONENT_middleware.safety

### Generate configuration

        config MCUX_PRJSEG_middleware.safety.generated_config
            bool "Generate configuration file"
            select SAFETY_GENERATED_CONFIGURATION
            default y
            help
				Generate default defines based on the used device. 
				Otherwise user needs to provide his own device_information.h.

        # Generate configuration header file
        if MCUX_PRJSEG_middleware.safety.generated_config

            menu "Configuration header (device_information.h)"

                config SAFETY_GENERATED_CONFIGURATION
                    bool
                    default y
                    help
                        Used generated Safety IEC60730b device_information.h header.
                        No prefix in generated macro

                config FPU_SUPPORT			 
					int "FPU"
					default 0 if MCUX_HW_NO_FPU
					default 1 if !MCUX_HW_NO_FPU				 
                    help
						No prefix in generated macro
						Set to 1 if device has FPU, or 0 if FPU is not available.
 
               config DSP_SUPPORT
					int "DSP"
					default 0 if !MCUX_HW_DSP
					default 1 if MCUX_HW_DSP
					help
						No prefix in generated macro
						Set to 1 if device has DSP, or 0 if DSP is not available.
						
               config TZ_SUPPORT
					int "TrustZone"
					default 0 if !MCUX_HW_SAU
					default 1 if MCUX_HW_SAU
					help
						No prefix in generated macro
						Set to 1 if device has TrustZone, or 0 if TrustZone is not available.
			
            endmenu

        endif
    endif
```

## FRDM-MCXA153/sdks/robox_sdk/mcuxsdk/middleware/safety_iec60730b/zephyr/Kconfig
```kconfig
# Copyright 2025 NXP
# SPDX-License-Identifier: Apache-2.0

menuconfig IEC60730B
    bool "Safety IEC60730B test library"
    help
      Enable the Safety IEC60730B test library.

if IEC60730B

    config IEC60730B_TEST_CPU_REG
        bool "IEC60730B CPU registers test routines"
        default y
        help
          Enable CPU register test routines for the IEC60730B safety library.
          This test verifies the integrity of CPU core registers by
          writing test patterns and reading them back to detect
          stuck-at faults and other register-related failures.

    config IEC60730B_TEST_CPU_REG_FPU
        bool "IEC60730B FPU registers test routines"
        default y
        depends on IEC60730B_TEST_CPU_REG && CPU_HAS_FPU
        select FPU
        help
          Enable Floating Point Unit (FPU) register test routines for
          the IEC60730B safety library. This test verifies the integrity of
          FPU registers by writing test patterns and reading them back
          to detect stuck-at faults in floating point registers.
          Requires FPU hardware support.

    config IEC60730B_TEST_CPU_REG_DSP
        bool "IEC60730B DSP registers test routines"
        default y
        depends on IEC60730B_TEST_CPU_REG && ARMV8_M_DSP
        help
          Enable Digital Signal Processing (DSP) register test routines
          for the IEC60730B safety library. This test verifies the
          integrity of DSP extension registers by writing test patterns
          and reading them back to detect stuck-at faults in DSP
          registers. Only available on ARMv8-M processors with DSP
          extension support.

    config IEC60730B_TEST_CPU_REG_TZ
        bool "IEC60730B Trust Zone registers test routines"
        default y
        depends on IEC60730B_TEST_CPU_REG && ARM_TRUSTZONE_M
        help
          Enable TrustZone register test routines for the IEC60730B safety library.
          This test verifies the integrity of TrustZone
          security extension registers by writing test patterns and
          reading them back to detect stuck-at faults in security-
          related registers. Only available on ARM processors with
          TrustZone-M support.

    config IEC60730B_TEST_PC
        bool "IEC60730B Program Counter test routines"
        default y
        help
          Enable Program Counter test routines for the IEC60730B safety library.
          The PC test verifies the proper execution flow and detects program counter
          corruption or unexpected jumps in code execution.

    config IEC60730B_TEST_RAM
        bool "IEC60730B RAM test routines"
        default y
        help
          Enable RAM test routines for the IEC60730B safety library.
          The RAM test verifies the integrity of system memory using various
          test patterns and algorithms to detect memory faults.

    config IEC60730B_TEST_FLASH
        bool "IEC60730B Flash Memory test routines"
        default y
        help
          Enable flash memory test routines for the IEC60730B safety library.
          This test verifies the integrity of flash memory contents
          using CRC methods.

    if IEC60730B_TEST_FLASH

    choice IEC60730B_TEST_FLASH_CRC
        prompt "CRC Algorithm Type"
        default IEC60730B_TEST_FLASH_CRC16 if CPU_CORTEX_M0PLUS
        default IEC60730B_TEST_FLASH_CRC32
        help
          Select the CRC algorithm type for flash memory integrity testing.
          Different CRC types provide different levels of error detection
          capability and performance characteristics.

    config IEC60730B_TEST_FLASH_CRC16
        bool "CRC-16"
        help
          16-bit CRC algorithm (CCITT - 0x1021).

    config IEC60730B_TEST_FLASH_CRC32
        bool "CRC-32"
        help
          32-bit CRC algorithm (MPEG-2 - 0x04C11DB7).

    endchoice

    config IEC60730B_TEST_FLASH_CRC_SEED
        hex "CRC seed value for flash test"
        default 0xFFFFFFFF
        help
          Initial seed value for CRC calculation.
          All 0xFF is standard for most CRC implementations.
          Must match the seed used when pre-calculating the
          expected CRC value.

    endif #IEC60730B_TEST_FLASH

    config IEC60730B_TEST_STACK
        bool "IEC60730B Stack Overflow test routines"
        default y
        help
          Enable stack overflow test routines for the IEC60730B safety library.
          This test monitors stack usage and detects stack overflow conditions
          to ensure system safety and reliability.

    config IEC60730B_TEST_AIO
        bool "IEC60730B Analog Input/Output test routines"
        default y
        help
          Enable Analog Input/Output (AIO) test routines for the IEC60730B safety library.
          This test verifies the integrity of analog input and
          output channels by checking ADC/DAC functionality, reference
          voltages, and signal path integrity. The test helps detect
          stuck-at faults, gain errors, and offset errors in analog
          signal processing circuits.

    config IEC60730B_TEST_CLOCK
        bool "IEC60730B Clock Frequency test routines"
        default y
        help
          Enable clock frequency test routines for the IEC60730B safety library.
          This test verifies the integrity and accuracy of system clocks
          by monitoring clock frequency, detecting clock failures, and
          ensuring proper timing for safety-critical operations. The test
          can detect clock source failures, PLL lock issues, and frequency
          drift that could affect system timing requirements.

    config IEC60730B_TEST_DIO
        bool "IEC60730B Digital Input/Output test routines"
        default y
        help
          Enable Digital Input/Output (DIO) test routines for the IEC60730B safety library.
          This test verifies the integrity of digital I/O pins
          by checking input/output functionality, pin state detection, and
          proper signal levels. The test can detect stuck-at faults,
          short circuits, open circuits, and other GPIO-related failures
          that could affect safety-critical I/O operations. Includes both
          basic DIO tests and extended DIO functionality tests.

    config IEC60730B_TEST_TSI
        bool "IEC60730B Touch Sensing Interface test routines"
        default y
        help
          Enable Touch Sensing Interface (TSI) test routines for the IEC60730B safety library.
          This test verifies the integrity of capacitive touch
          sensing functionality by checking electrode sensitivity, baseline
          calibration, and touch detection accuracy. The test can detect
          electrode failures, sensitivity drift, noise interference, and
          other touch sensing related failures that could affect safety-
          critical touch interface operations.

    config IEC60730B_TEST_WDOG
        bool "IEC60730B Watchdog Test routines"
        default y
        help
          Enable Watchdog Timer test routines for the IEC60730B safety library.
          This test verifies the proper operation of the watchdog timer
          by checking timeout functionality, reset generation, and proper
          refresh mechanisms. The test ensures that the watchdog can detect
          software failures and generate system resets when required for
          safety-critical applications.

endif # IEC60730B
```

## FRDM-MCXA153/sdks/robox_sdk/mcuxsdk/middleware/safety_iec60730b/zephyr/samples/safety/Kconfig
```kconfig
# Copyright 2025 NXP
# SPDX-License-Identifier: Apache-2.0

mainmenu "Safety iec60730b sample application"

config APP_SAFETY_THREAD_STACK_SIZE
	int "Safety test thread stack size"
	default 1024
	help
	  Stack size in bytes for the safety test thread.
	  This thread runs periodic safety tests and monitors system health.
	  Increase this value if the safety tests require more stack space.

config APP_SAFETY_THREAD_PRIORITY
	int "Safety test thread priority"
	default -16 
	help
	  Priority level for the safety test thread.
	  Lower values indicate higher priority.
	  By default set to the absolute highest priority -16 for critical safety functions.

config APP_SAFETY_PERIOD_MS
	int "Safety test execution period in milliseconds"
	default 1000
	help
	  Time period in milliseconds between safety test executions.
	  This determines how frequently the safety tests are run.
	  Shorter periods provide faster error detection but consume more CPU.
	  Longer periods reduce CPU usage but may delay error detection.

config APP_SAFETY_LOG_LEVEL
	int "Safety tests log level"
	default 3
	range 0 4
	depends on LOG
	help
	  Sets the log level for the safety tests module.
	  Levels: 0=OFF, 1=ERROR, 2=WARNING, 3=INFO, 4=DEBUG

choice APP_SAFETY_ERROR_ACTION
	prompt "Safety Error Action"
	default APP_SAFETY_ERROR_ACTION_INFINITE_LOOP
	help
	  Select the action to take when a safety error is detected.

config APP_SAFETY_ERROR_ACTION_INFINITE_LOOP
	bool "Infinite Loop"
	help
	  When a safety error is detected, disable interrupts and enter an infinite loop,
	  The system will be stuck in a loop, preventing further execution
	  while maintaining processor activity. This can be useful for
	  debugging or when a controlled hang is preferred over a no action.

config APP_SAFETY_ERROR_ACTION_RESET
	bool "System Reset"
	help
	  When a safety error is detected, immediately perform a cold system reset.
	  This allows for quick recovery from safety violations.

endchoice

config APP_SAFETY_TASK_WATCHDOG
    bool "Enable Safety Task Watchdog"
    default y
    depends on TASK_WDT
    help
      Enable task watchdog for safety monitoring. The task watchdog
      monitors the safety test thread and triggers a callback if
      the thread fails to feed the watchdog within the specified timeout.
      This provides an additional safety mechanism to detect thread
      failures or system hangs.

if APP_SAFETY_TASK_WATCHDOG

config APP_SAFETY_TASK_WATCHDOG_TIMEOUT_MS
    int "Task watchdog timeout in milliseconds"
    default 10000
    help
      Timeout value for the safety task watchdog in milliseconds.
      This should be larger than CONFIG_APP_SAFETY_TESTS_PERIOD_MS
      to allow for test execution time. If the safety thread doesn't
      feed the watchdog within this time, the callback will be triggered.

endif # APP_SAFETY_TASK_WATCHDOG

if IEC60730B_TEST_RAM

config APP_SAFETY_TEST_RAM_BUFFER_SIZE
	int "Safety RAM test buffer size in bytes"
	default 1024
	help
	  Size of the RAM buffer used for safety RAM testing.
	  This buffer is used to perform RAM integrity tests according to IEC60730B.

config APP_SAFETY_TEST_RAM_BACKUP_BUFFER_SIZE
	int "Safety RAM test backup buffer size in bytes"
	default 32
	help
	  Size of the backup buffer used during RAM safety testing.
	  This buffer stores the original data while the main buffer is being tested.

endif #IEC60730B_TEST_RAM

if IEC60730B_TEST_STACK

config APP_SAFETY_TEST_STACK_GUARD_SIZE
	int "Stack test guard size for overflow detection"
	default 128
	help
	  Size in bytes of the guard areas placed before and after the stack
	  for overflow detection. The guard areas are filled with a test pattern
	  to detect stack overflow conditions.
	  Must be aligned to pointer size (4 bytes).

config APP_SAFETY_TEST_STACK_GUARD_PATTERN
	hex "Stack test gaurd pattern for overflow detection"
	default 0xA5A5A5A5
	help
	  32-bit pattern used to fill stack guard areas for overflow detection.
	  The pattern should be chosen to be easily detectable when corrupted
	  and unlikely to occur naturally in normal program execution.

endif #IEC60730B_TEST_STACK

source "Kconfig.zephyr"
```

## FRDM-MCXA153/sdks/robox_sdk/mcuxsdk/middleware/safety_iec60730b/zephyr/samples/safety/sample.yaml
```yaml
sample:
  name: Safety iec60730b Sample
tests:
  sample.iec60730b.safety:
    tags:
      - safety
    integration_platforms:
      - frdm_rw612
```

## FRDM_MCXA153/robox/__repo__/mcuxsdk/components/els_pkc/zephyr/Kconfig
```kconfig
# MCUXpresso SDK HW_ACCL els_pkc

# Copyright (c) 2024, NXP
# SPDX-License-Identifier: Apache-2.0

config MCUX_ELS_PKC
	bool "Build els_pkc"
	default y if BUILD_WITH_TFM
	help
	    Include the els_pkc component from the NXP MCU SDK in the build.
```
